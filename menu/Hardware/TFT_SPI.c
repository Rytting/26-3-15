#include "TFT_SPI.h"
#include "Delay.h"

#define TFT_CS_PIN    GPIO_Pin_0
#define TFT_DC_PIN    GPIO_Pin_1
#define TFT_SCK_PIN   GPIO_Pin_5
#define TFT_MOSI_PIN  GPIO_Pin_7

#define TFT_CTRL_PORT GPIOB
#define TFT_SPI_PORT  GPIOA

#define CS_LOW()  GPIO_ResetBits(TFT_CTRL_PORT, TFT_CS_PIN)
#define CS_HIGH() GPIO_SetBits(TFT_CTRL_PORT, TFT_CS_PIN)
#define DC_LOW()  GPIO_ResetBits(TFT_CTRL_PORT, TFT_DC_PIN)
#define DC_HIGH() GPIO_SetBits(TFT_CTRL_PORT, TFT_DC_PIN)

void SPI_Write(uint8_t dat)
{
    while(SPI_I2S_GetFlagStatus(SPI1, SPI_I2S_FLAG_TXE) == RESET);
    SPI_I2S_SendData(SPI1, dat);
    while(SPI_I2S_GetFlagStatus(SPI1, SPI_I2S_FLAG_BSY) == SET);
}

void TFT_Write_Cmd(uint8_t cmd)
{
    CS_LOW();
    DC_LOW();
    SPI_Write(cmd);
    CS_HIGH();
}

void TFT_Write_Data(uint8_t dat)
{
    CS_LOW();
    DC_HIGH();
    SPI_Write(dat);
    CS_HIGH();
}

void TFT_SetWindow(uint16_t x, uint16_t y, uint16_t w, uint16_t h)
{
    TFT_Write_Cmd(0x2A);
    TFT_Write_Data(x>>8);
    TFT_Write_Data(x&0xFF);
    TFT_Write_Data((x+w-1)>>8);
    TFT_Write_Data((x+w-1)&0xFF);

    TFT_Write_Cmd(0x2B);
    TFT_Write_Data(y>>8);
    TFT_Write_Data(y&0xFF);
    TFT_Write_Data((y+h-1)>>8);
    TFT_Write_Data((y+h-1)&0xFF);

    TFT_Write_Cmd(0x2C);
}

void TFT_Init(void)
{
    GPIO_InitTypeDef GPIO_InitStruct;
    SPI_InitTypeDef SPI_InitStruct;

    RCC_APB2PeriphClockCmd(RCC_APB2Periph_GPIOA | RCC_APB2Periph_GPIOB | RCC_APB2Periph_SPI1, ENABLE);

    GPIO_InitStruct.GPIO_Mode = GPIO_Mode_AF_PP;
    GPIO_InitStruct.GPIO_Speed = GPIO_Speed_50MHz;
    GPIO_InitStruct.GPIO_Pin = TFT_SCK_PIN | TFT_MOSI_PIN;
    GPIO_Init(TFT_SPI_PORT, &GPIO_InitStruct);

    GPIO_InitStruct.GPIO_Mode = GPIO_Mode_Out_PP;
    GPIO_InitStruct.GPIO_Speed = GPIO_Speed_50MHz;
    GPIO_InitStruct.GPIO_Pin = TFT_CS_PIN | TFT_DC_PIN;
    GPIO_Init(TFT_CTRL_PORT, &GPIO_InitStruct);

    SPI_InitStruct.SPI_Direction = SPI_Direction_1Line_Tx;
    SPI_InitStruct.SPI_Mode = SPI_Mode_Master;
    SPI_InitStruct.SPI_DataSize = SPI_DataSize_8b;
    SPI_InitStruct.SPI_CPOL = SPI_CPOL_Low;
    SPI_InitStruct.SPI_CPHA = SPI_CPHA_1Edge;
    SPI_InitStruct.SPI_NSS = SPI_NSS_Soft;
    SPI_InitStruct.SPI_BaudRatePrescaler = SPI_BaudRatePrescaler_16;
    SPI_InitStruct.SPI_FirstBit = SPI_FirstBit_MSB;
    SPI_Init(SPI1, &SPI_InitStruct);
    SPI_Cmd(SPI1, ENABLE);

    Delay_ms(120);

    TFT_Write_Cmd(0xCF);
    TFT_Write_Data(0x00);TFT_Write_Data(0xC1);TFT_Write_Data(0x30);
    TFT_Write_Cmd(0xED);
    TFT_Write_Data(0x64);TFT_Write_Data(0x03);TFT_Write_Data(0x12);TFT_Write_Data(0x81);
    TFT_Write_Cmd(0xE8);
    TFT_Write_Data(0x85);TFT_Write_Data(0x00);TFT_Write_Data(0x78);
    TFT_Write_Cmd(0xCB);
    TFT_Write_Data(0x39);TFT_Write_Data(0x2C);TFT_Write_Data(0x00);TFT_Write_Data(0x34);TFT_Write_Data(0x02);
    TFT_Write_Cmd(0xF7);
    TFT_Write_Data(0x20);
    TFT_Write_Cmd(0xEA);
    TFT_Write_Data(0x00);TFT_Write_Data(0x00);
    TFT_Write_Cmd(0xC0);
    TFT_Write_Data(0x1B);
    TFT_Write_Cmd(0xC1);
    TFT_Write_Data(0x01);
    TFT_Write_Cmd(0xC5);
    TFT_Write_Data(0x30);TFT_Write_Data(0x30);
    TFT_Write_Cmd(0xC7);
    TFT_Write_Data(0xB7);
    TFT_Write_Cmd(0x36);
    TFT_Write_Data(0xE8);
    TFT_Write_Cmd(0x3A);
    TFT_Write_Data(0x55);
    TFT_Write_Cmd(0xB1);
    TFT_Write_Data(0x00);TFT_Write_Data(0x18);
    TFT_Write_Cmd(0xB6);
    TFT_Write_Data(0x08);TFT_Write_Data(0x82);TFT_Write_Data(0x27);
    TFT_Write_Cmd(0xF2);
    TFT_Write_Data(0x00);
    TFT_Write_Cmd(0x26);
    TFT_Write_Data(0x01);
    TFT_Write_Cmd(0xE0);
    TFT_Write_Data(0x0F);TFT_Write_Data(0x31);TFT_Write_Data(0x2B);TFT_Write_Data(0x0C);TFT_Write_Data(0x0E);TFT_Write_Data(0x08);TFT_Write_Data(0x4E);TFT_Write_Data(0xF1);TFT_Write_Data(0x37);TFT_Write_Data(0x07);TFT_Write_Data(0x10);TFT_Write_Data(0x03);TFT_Write_Data(0x0E);TFT_Write_Data(0x09);TFT_Write_Data(0x00);
    TFT_Write_Cmd(0xE1);
    TFT_Write_Data(0x00);TFT_Write_Data(0x0E);TFT_Write_Data(0x14);TFT_Write_Data(0x03);TFT_Write_Data(0x11);TFT_Write_Data(0x07);TFT_Write_Data(0x31);TFT_Write_Data(0xC1);TFT_Write_Data(0x48);TFT_Write_Data(0x08);TFT_Write_Data(0x0F);TFT_Write_Data(0x0C);TFT_Write_Data(0x31);TFT_Write_Data(0x36);TFT_Write_Data(0x0F);
    TFT_Write_Cmd(0x11);
    Delay_ms(120);
    TFT_Write_Cmd(0x29);

}

void TFT_DrawPoint(uint16_t x, uint16_t y, uint16_t color)
{
    if(x >= TFT_WIDTH || y >= TFT_HEIGHT) return;

    TFT_SetWindow(x, y, 1, 1);
    CS_LOW();
    DC_HIGH();
    SPI_Write(color >> 8);
    SPI_Write(color & 0xFF);
    CS_HIGH();
}

void TFT_Clear(uint16_t color)
{
    uint16_t i,j;
    TFT_SetWindow(0,0,320,240);
    CS_LOW();
    DC_HIGH();
    for(i=0;i<320;i++)
    {
        for(j=0;j<240;j++)
        {
            SPI_Write(color>>8);
            SPI_Write(color&0xFF);
        }
    }
    CS_HIGH();
}
// 清指定矩形区域（x,y为起点，w为宽度，h为高度，color为填充色）
void TFT_ClearRect(uint16_t x, uint16_t y, uint16_t w, uint16_t h, uint16_t color)
{
    uint16_t i, j;

    if(x >= TFT_WIDTH || y >= TFT_HEIGHT) return;
    if((x + w) > TFT_WIDTH || (y + h) > TFT_HEIGHT) return;

    TFT_SetWindow(x, y, w, h);
    CS_LOW();
    DC_HIGH();
    for(i = 0; i < h; i++)
    {
        for(j = 0; j < w; j++)
        {
            SPI_Write(color >> 8);
            SPI_Write(color & 0xFF);
        }
    }
    CS_HIGH();
}

#ifndef __TFT_FONT_H
#define __TFT_FONT_H

#include "stm32f10x.h"

const uint8_t ASCII_8x8[95][8] =
{
    {0x00,0x00,0x00,0x00,0x00,0x00,0x00,0x00}, //  
    {0x00,0x00,0x00,0x5F,0x5F,0x00,0x00,0x00}, // !
    {0x00,0x00,0x07,0x07,0x00,0x07,0x07,0x00}, // "
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    {0x02,0x03,0x01,0x03,0x02,0x03,0x01,0x00}  // ~
};

#endif


void TFT_FillBlock(uint16_t x, uint16_t y, uint8_t size, uint16_t color)
{
    uint8_t i, j;
    for(i = 0; i < size; i++)
    {
        for(j = 0; j < size; j++)
        {
            TFT_DrawPoint(x + j, y + i, color);
        }
    }
}

void TFT_ShowChar(uint16_t x, uint16_t y, uint8_t ch, uint16_t color)
{
    uint8_t col, row;
    uint8_t temp;
    uint8_t index;
    uint8_t size = 2;   // 字体放大倍数

    if(ch < 0x20 || ch > 0x7E) return;
    index = ch - 0x20;

    for(col = 0; col < 8; col++)
    {
        temp = ASCII_8x8[index][col];
        for(row = 0; row < 8; row++)
        {
            if(temp & (1 << row))
            {
                TFT_FillBlock(x + col * size, y + row * size, size, color);
            }
        }
    }
}

void TFT_ShowString(uint16_t x, uint16_t y, char *str, uint16_t color)
{
    uint16_t cur_x = x;
    uint16_t cur_y = y;
    uint8_t size = 2;   // 和 ShowChar 保持一致

    while(*str)
    {
        if(*str == '\n')
        {
            cur_x = x;
            cur_y += 8 * size + 4;
            str++;
            continue;
        }

        TFT_ShowChar(cur_x, cur_y, *str, color);
        cur_x += 8 * size;

        if(cur_x >= TFT_WIDTH - 8 * size)
        {
            cur_x = x;
            cur_y += 8 * size + 4;
        }

        str++;
    }
}
